## vm/pg_defconfig
```kconfig
# Minimal RISC-V kernel config for PostgreSQL in emulator
# Based on what works with the existing emulator
# Key: CONFIG_MULTIUSER=y for setuid/setgid support

# Architecture
CONFIG_RISCV=y
CONFIG_64BIT=y
CONFIG_SMP=y
CONFIG_NR_CPUS=1

# Core subsystems
CONFIG_MULTIUSER=y
CONFIG_SYSVIPC=y
CONFIG_POSIX_MQUEUE=y
CONFIG_FUTEX=y
CONFIG_EPOLL=y
CONFIG_SIGNALFD=y
CONFIG_TIMERFD=y
CONFIG_EVENTFD=y
CONFIG_AIO=y
CONFIG_ADVISE_SYSCALLS=y
CONFIG_FHANDLE=y
CONFIG_POSIX_TIMERS=y

# Memory
CONFIG_MMU=y
CONFIG_FLATMEM=y
CONFIG_PAGE_OFFSET=0xffffaf8000000000
CONFIG_PHYS_RAM_BASE=0x80000000

# Filesystem
CONFIG_EXT2_FS=y
CONFIG_EXT4_FS=y
CONFIG_PROC_FS=y
CONFIG_PROC_SYSCTL=y
CONFIG_SYSFS=y
CONFIG_TMPFS=y
CONFIG_DEVTMPFS=y
CONFIG_DEVTMPFS_MOUNT=y
CONFIG_UNIX=y

# Block device
CONFIG_BLK_DEV=y
CONFIG_VIRTIO=y
CONFIG_VIRTIO_MMIO=y
CONFIG_VIRTIO_BLK=y
CONFIG_VIRTIO_CONSOLE=y

# Serial console
CONFIG_SERIAL_8250=y
CONFIG_SERIAL_8250_CONSOLE=y
CONFIG_SERIAL_EARLYCON=y
CONFIG_SERIAL_OF_PLATFORM=y

# Initrd support
CONFIG_BLK_DEV_INITRD=y
CONFIG_INITRAMFS_SOURCE=""
CONFIG_RD_GZIP=y

# Device tree
CONFIG_OF=y
CONFIG_OF_EARLY_FLATTREE=y

# Timer
CONFIG_RISCV_TIMER=y
CONFIG_HZ_100=y
CONFIG_HZ=100

# Disable security modules that block setuid
# CONFIG_SECURITY is not set
# CONFIG_SECURITY_SELINUX is not set
# CONFIG_SECURITY_APPARMOR is not set
# CONFIG_AUDIT is not set

# Networking minimal (for psql unix sockets)
CONFIG_NET=y
CONFIG_INET=y
CONFIG_PACKET=y
CONFIG_UNIX98_PTYS=y

# Performance
CONFIG_KALLSYMS=y
CONFIG_PRINTK=y
CONFIG_BUG=y

# No modules
# CONFIG_MODULES is not set

# No compat (simpler syscall table)
# CONFIG_COMPAT is not set

# No debug
# CONFIG_DEBUG_KERNEL is not set
# CONFIG_KGDB is not set
```
